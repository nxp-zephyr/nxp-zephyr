## dts/bindings/bluetooth/nxp,bt-hci-uart.yaml
```yaml
# Copyright 2024 NXP
# SPDX-License-Identifier: Apache-2.0

description: |
    Bluetooth module that uses NXP's Bluetooth Module (e.g. Murata 2EL)

compatible: "nxp,bt-hci-uart"

include: base.yaml

properties:
  sdio-reset-gpios:
    type: phandle-array
    required: true

  w-disable-gpios:
    type: phandle-array
    required: true

  hci-default-speed:
    type: int
    description: |
      HCI UART default baudrate after the FW download. If not defined
      bus/current-speed will be used as default.

  hci-operation-speed:
    type: int
    description: |
      HCI UART running baudrate for feature operation. If not defined
      hci-default-speed will be used as default.
      When hci-operation-speed is different with hci-default-speed,
      the HCI UART baudrate update process will be involved to change
      the HCI UART baudrate from hci-default-speed to
      hci-operation-speed.

  hw-flow-control:
    type: boolean
    description: Set to enable RTS/CTS flow control for HCI.

  fw-download-primary-speed:
    type: int
    description: |
      HCI UART primary baudrate for FW download operation.
      If not defined bus/current-speed will be used as default.

  fw-download-primary-flowcontrol:
    type: boolean
    description: |
      Flow control setting for primary speed.

  fw-download-secondary-speed:
    type: int
    description: |
      HCI UART secondary baudrate for FW download operation.
      If not defined bus/current-speed will be used as default.

  fw-download-secondary-flowcontrol:
    type: boolean
    description: |
      Flow control setting for secondary speed.
```
